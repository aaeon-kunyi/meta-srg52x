## conf/distro/srg52-buster.conf
```bitbake
#
# SRG-335x Debian Buster
#
# Copyright (c) LYD/AAEON, 2020
#
# Authors:
#  KunYi <kunyi.chen@gmail.com>
#
# SPDX-License-Identifier: MIT
#

require conf/distro/debian-buster.conf

KERNEL_NAME ?= "srg52-rt"

DISTRO_APT_SOURCES = "conf/distro/debian-buster.list"

WKS_FILE ?= "${MACHINE}.wks"

PREFERRED_VERSION_srg52-rt ?= "4.19.%"
```

## conf/layer.conf
```bitbake
#
# SRG-335x Debian Buster
#
# Copyright (c) LYD/AAEON, 2020
#
# Authors:
#  KunYi <kunyi.chen@gmail.com>
#
# SPDX-License-Identifier: MIT
#

BBPATH .= ":${LAYERDIR}"

BBFILES += "${LAYERDIR}/recipes-*/*/*.bb \
        ${LAYERDIR}/recipes-*/*/*.bbappend"

BBFILE_COLLECTIONS += "srg52-buster"
BBFILE_PATTERN_srg52-buster = "^${LAYERDIR}/"
BBFILE_PRIORITY_srg52-buster = "6"

LAYERSERIES_COMPAT_srg52-buster = "next"

LAYERDIR_srg52-buster = "${LAYERDIR}"
```

## conf/machine/srg-3352c.conf
```bitbake
#
# SRG-335x Debian Buster
#
# Copyright (c) LYD/AAEON, 2020
#
# Authors:
#  KunYi <kunyi.chen@gmail.com>
#
# SPDX-License-Identifier: MIT
#

DISTRO_ARCH = "armhf"

IMAGE_TYPE ?= "wic-img"
#IMAGE_TYPE ?= "targz-img"
# change u-boot
PREFERRED_PROVIDER_u-boot-${MACHINE} = "u-boot-srg-3352c"
PREFERRED_PROVIDER_u-boot-tools = "u-boot-srg-3352c"
U_BOOT_TOOLS_PACKAGE = "1"
U_BOOT_CONFIG_srg-3352c = "srg3352_defconfig"
U_BOOT_CONFIG_srg-3352 = "srg3352_defconfig"

KERNEL_DEFCONFIG = "srg52_defconfig"

DTB_FILES_srg-3352c ?= " am335x-srg3352c.dtb am335x-srg3352.dtb"

# add u-boot-srg52 into build dependence
# will build package 'u-boot-srg-3352c'
# and install u-boot into root filesystem
IMAGER_BUILD_DEPS += "u-boot-srg-3352c"
IMAGER_INSTALL += "u-boot-srg-3352c"
# install u-boot-script
IMAGE_INSTALL += "u-boot-script"

# install wl1831 wireless/bluetooth firmware package
IMAGE_INSTALL += "srg52-wl183x"
# install am335x power management firmware package
IMAGE_INSTALL += "am335x-pm"
```

## wic/srg-3352.wks
```
#
# SRG-335x Debian Buster
#
# Copyright (c) LYD/AAEON, 2020
#
# Authors:
#   KunYi <kunyi.chen@gmail.com>
#
# SPDX-License-Identifier: MIT
#

part --source rawcopy --sourceparams "file=/usr/lib/u-boot/am335x_boneblack/MLO" --no-table --align 128
part --source rawcopy --sourceparams "file=/usr/lib/u-boot/am335x_boneblack/u-boot.img" --no-table --align 384

part --ondisk mmcblk0 --fstype ext4 --label reserved --align 1024 --size 50M
#part / --source rootfs-u-boot --ondisk mmcblk0 --fstype ext4 --label platform --align 1024 --active --extra-space 128M
part / --source rootfs-u-boot --ondisk mmcblk0 --fstype ext4 --label platform --align 1024 --active

bootloader --append "rootwait console=ttyO,115200"
```

## wic/srg-3352c.wks
```
#
# SRG-335x Debian Buster
#
# Copyright (c) LYD/AAEON, 2020
#
# Authors:
#   KunYi <kunyi.chen@gmail.com>
#
# SPDX-License-Identifier: MIT
#

part --source rawcopy --sourceparams "file=/usr/lib/u-boot/srg-3352c/MLO" --no-table --align 128
part --source rawcopy --sourceparams "file=/usr/lib/u-boot/srg-3352c/u-boot.img" --no-table --align 384

part --source bootpart --ondisk mmcblk0 --align 1024 --size 64M --extra-space 0 --active
part / --source rootfs --ondisk mmcblk0 --fstype ext4 --label rootfs --use-uuid --align 1024 --extra-space 128M
```
